## boards/shields/matrix4x4/Kconfig.defconfig
```kconfig
# config/boards/shields/matrix4x4/Kconfig.defconfig

if SHIELD_MATRIX4X4

config ZMK_KEYBOARD_NAME
    default "Matrix4x4"

endif
```

## boards/shields/matrix4x4/Kconfig.shield
```kconfig
# config/boards/shields/matrix4x4/Kconfig.shield

config SHIELD_MATRIX4X4
    def_bool $(shields_list_contains,matrix4x4)
```
